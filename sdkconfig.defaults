## sdkconfig.defaults
```kconfig
# PSRAM configuration for ESP32-S3-PICO-1-N8R8 (Octal PSRAM)
CONFIG_SPIRAM=y
CONFIG_SPIRAM_MODE_OCT=y
CONFIG_SPIRAM_SPEED_80M=y

# Memory allocation
CONFIG_SPIRAM_USE_MALLOC=y
CONFIG_SPIRAM_MALLOC_ALWAYSINTERNAL=4096

# Watchdog configuration
CONFIG_ESP_TASK_WDT_INIT=y
CONFIG_ESP_TASK_WDT_EN=y
CONFIG_ESP_TASK_WDT_TIMEOUT_S=10
```
